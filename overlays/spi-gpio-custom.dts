/dts-v1/;
/plugin/;
&{/} {
    spi_gpio_custom {
        compatible = "spi-gpio";
        #address-cells = <1>;
        #size-cells = <0>;
        pinctrl-names = "default";
        pinctrl-0 = <&hat_19_gpio &hat_21_gpio &hat_23_gpio &hat_24_gpio &hat_26_gpio>;
        sck-gpios = <&mcu_gpio0 2 0>;
        mosi-gpios = <&mcu_gpio0 3 0>;
        miso-gpios = <&mcu_gpio0 4 0>;
        cs-gpios = <&mcu_gpio0 0 0>, <&mcu_gpio0 9 0>;
        num-chipselects = <2>;
        status = "okay";
        channel@0 {
            compatible = "rohm,dh2228fv";
            reg = <0>;
            spi-max-frequency = <1000000>;
        };
        channel@1 {
            compatible = "rohm,dh2228fv";
            reg = <1>;
            spi-max-frequency = <1000000>;
        };
    };
};
